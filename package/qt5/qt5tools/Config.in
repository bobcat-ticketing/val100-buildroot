## package/qt5/qt5tools/Config.in
```kconfig
config BR2_PACKAGE_QT5TOOLS
	bool "qt5tools"
	select BR2_PACKAGE_QT5BASE
	help
	  Qt is a cross-platform application and UI framework for
	  developers using C++.

	  This package corresponds to qttools and builds QtHelp and QtUiTools 
	  for the target and Linguist's command line tools for the host.

	  http://qt-project.org
```

## package/tesseract/Config.in
```kconfig
# Tesseract engine & language training data
source "package/tesseract/tesseract/Config.in"
```

## package/tesseract/tesseract-ocr-chi-sim/Config.in
```kconfig
config BR2_PACKAGE_TESSERACT_OCR_CHI_SIM
	bool "Simplified Chinese language support"
	depends on BR2_PACKAGE_TESSERACT
	help
	  This will install the simplified chinese training data file
	  for tesseract
```

## package/tesseract/tesseract-ocr-chi-tra/Config.in
```kconfig
config BR2_PACKAGE_TESSERACT_OCR_CHI_TRA
	bool "Traditional Chinese language support"
	depends on BR2_PACKAGE_TESSERACT
	help
	  This will install the traditional chinese training data file
	  for tesseract
```

## package/tesseract/tesseract-ocr-deu/Config.in
```kconfig
config BR2_PACKAGE_TESSERACT_OCR_DEU
	bool "German language support"
	depends on BR2_PACKAGE_TESSERACT
	help
	  This will install the german language training data file for tesseract
```

## package/tesseract/tesseract-ocr-eng/Config.in
```kconfig
config BR2_PACKAGE_TESSERACT_OCR_ENG
	bool "English language support"
	depends on BR2_PACKAGE_TESSERACT
	help
	  This will install the english training data file for tesseract
```

## package/tesseract/tesseract-ocr-fra/Config.in
```kconfig
config BR2_PACKAGE_TESSERACT_OCR_FRA
	bool "French language support"
	depends on BR2_PACKAGE_TESSERACT
	help
	  This will install the french training data file for tesseract
```

## package/tesseract/tesseract-ocr-hin/Config.in
```kconfig
config BR2_PACKAGE_TESSERACT_OCR_HIN
	bool "Hindi language support"
	depends on BR2_PACKAGE_TESSERACT
	help
	  This will install the hindi language training data file for tesseract
```

## package/tesseract/tesseract-ocr-jpn/Config.in
```kconfig
config BR2_PACKAGE_TESSERACT_OCR_JPN
	bool "Japanese language support"
	depends on BR2_PACKAGE_TESSERACT
	help
	  This will install the japanese training data file for tesseract
```

## package/tesseract/tesseract-ocr-kor/Config.in
```kconfig
config BR2_PACKAGE_TESSERACT_OCR_KOR
	bool "Korean language support"
	depends on BR2_PACKAGE_TESSERACT
	help
	  This will install the korean language training data file
	  for tesseract
```

## package/tesseract/tesseract-ocr-nld/Config.in
```kconfig
config BR2_PACKAGE_TESSERACT_OCR_NLD
	bool "Dutch language support"
	depends on BR2_PACKAGE_TESSERACT
	help
	  This installs the dutch language training data file for tesseract
```

## package/tesseract/tesseract-ocr-rus/Config.in
```kconfig
config BR2_PACKAGE_TESSERACT_OCR_RUS
	bool "Russian language support"
	depends on BR2_PACKAGE_TESSERACT
	help
	  This will install the russian language training data file
	  for tesseract
```

## package/tesseract/tesseract-ocr-spa/Config.in
```kconfig
config BR2_PACKAGE_TESSERACT_OCR_SPA
	bool "Spanish language support"
	depends on BR2_PACKAGE_TESSERACT
	help
	  This will install the spanish training data file for tesseract
```

## package/tesseract/tesseract/Config.in
```kconfig
config BR2_PACKAGE_TESSERACT
	bool "tesseract"
	depends on BR2_INSTALL_LIBSTDCPP
	select BR2_PACKAGE_LEPTONICA
	select BR2_PACKAGE_TESSERACT_OCR_ENG
	help
	  Tesseract is an OCR (Optical Character Recognition) engine,
	  It can be used directly, or (for programmers) using an API.
	  It supports a wide variety of languages.

	  http://code.google.com/p/tesseract-ocr/

comment "tesseract needs a toolchain with C++ support"
	depends on !BR2_INSTALL_LIBSTDCPP


if BR2_PACKAGE_TESSERACT
	menu "tesseract image file format support"

	config BR2_PACKAGE_TESSERACT_JPEG
		bool "enable JPEG file format support"
		select BR2_PACKAGE_JPEG
		default y

	config BR2_PACKAGE_TESSERACT_PNG
		bool "enable PNG file format support"
		select BR2_PACKAGE_LIBPNG
		default y

	config BR2_PACKAGE_TESSERACT_TIFF
		bool "enable TIFF file format support"
		select BR2_PACKAGE_TIFF

	endmenu

	menu "tesseract language support"
		source "package/tesseract/tesseract-ocr-eng/Config.in"
		source "package/tesseract/tesseract-ocr-fra/Config.in"
		source "package/tesseract/tesseract-ocr-spa/Config.in"
		source "package/tesseract/tesseract-ocr-deu/Config.in"
		source "package/tesseract/tesseract-ocr-chi-sim/Config.in"
		source "package/tesseract/tesseract-ocr-chi-tra/Config.in"
		source "package/tesseract/tesseract-ocr-jpn/Config.in"
		source "package/tesseract/tesseract-ocr-rus/Config.in"
		source "package/tesseract/tesseract-ocr-nld/Config.in"
		source "package/tesseract/tesseract-ocr-hin/Config.in"
		source "package/tesseract/tesseract-ocr-kor/Config.in"
	endmenu
endif
```
